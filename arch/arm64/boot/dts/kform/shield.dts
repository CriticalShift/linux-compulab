// SPDX-License-Identifier: (GPL-2.0+ OR MIT)
/*
 * Copyright 2021 CompuLab
 */

/dts-v1/;

/* Core modules */
#include "../freescale/imx8mp.dtsi"
#include "shield-core.dtsi"

/* Peripherals */
#include "shield-cell.dtsi"
#include "shield-ethernet0.dtsi"
#include "shield-ethernet1.dtsi"
#include "shield-leds.dtsi"
#include "shield-wifi.dtsi"

/ {
	model = "Kform Shield";
	compatible = "compulab,ucm-imx8m-plus", "fsl,imx8mp";
};
